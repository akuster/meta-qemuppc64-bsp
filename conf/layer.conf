## conf/layer.conf
```bitbake
# We have a conf and classes directory, add to BBPATH
BBPATH .= ":${LAYERDIR}"

# We have a recipes-* directories, add to BBFILES
BBFILES += "${LAYERDIR}/recipes-*/*/*.bb \
	${LAYERDIR}/recipes-*/*/*.bbappend"

BBFILE_COLLECTIONS += "karch"
BBFILE_PATTERN_karch = "^${LAYERDIR}/"
BBFILE_PRIORITY_karch = "6"
```

## conf/machine/qemuppc64.conf
```bitbake
#@TYPE: Machine
#@NAME: qemu PPC 64 Emulator setup
#@DESCRIPTION: Machine configuration for running an PPC system under qemu emulation

require conf/machine/include/qemu.inc
DEFAULTTUNE ?= "ppc64p6"
require conf/machine/include/tune-ppcpower6.inc

MACHINEOVERRIDES .= ":ppc64p6"

require conf/multilib.conf
MULTILIBS = "multilib:lib32"
DEFAULTTUNE_virtclass-multilib-lib32 = "ppcp6"

KERNEL_IMAGETYPE = "vmlinux"

MACHINE_FEATURES += "screen keyboard pci usbhost ext2 ext3 serial "

MACHINE_EXTRA_RRECOMMENDS = " kernel-modules"
IMAGE_FSTYPES = "ext2 ext3 cpio.gz"

SERIAL_CONSOLE ?= "9600 hvc0"

PREFERRED_PROVIDER_virtual/xserver ?= "xserver-xorg"

XSERVER = " \
    xserver-xorg \
    xf86-input-evdev \
    xf86-input-mouse \
    xf86-input-keyboard \
    xf86-video-fbdev \
"
```
